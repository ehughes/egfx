## CMakeLists.txt
```
cmake_minimum_required(VERSION 3.20.0)

# Configure eGFX
set(EGFX_BASE_DIR "${CMAKE_CURRENT_LIST_DIR}/../../../../")

find_package(Zephyr REQUIRED HINTS $ENV{ZEPHYR_BASE})
project(egfx_test_320_172_16BPP_RGB565)

# Add application source
target_sources(app PRIVATE src/main.c)

# Add application includes (for eGFX_Config.h)
target_include_directories(app PRIVATE src)

# eGFX library is included via the Zephyr module system
# See egfx/lib/zephyr/CMakeLists.txt
```

## prj.conf
```kconfig
# eGFX Configuration
CONFIG_EGFX=y

# Display Configuration
CONFIG_EGFX_PHYSICAL_SCREEN_SIZE_X=320
CONFIG_EGFX_PHYSICAL_SCREEN_SIZE_Y=172
CONFIG_EGFX_DISPLAY_DRIVER_IMG_TYPE=EGFX_IMG_16BPP_RGB565

# Zephyr Display Driver
CONFIG_DISPLAY=y
CONFIG_SDL_DISPLAY=y
CONFIG_SDL_DISPLAY_DEFAULT_PIXEL_FORMAT_RGB_565=y

# Console and Logging
CONFIG_CONSOLE=y
CONFIG_PRINTK=y
CONFIG_LOG=y
CONFIG_LOG_DEFAULT_LEVEL=3

# Heap size
CONFIG_HEAP_MEM_POOL_SIZE=65536
```

## native_sim.overlay
```dts
/*
 * Device tree overlay for native_sim display
 * Configures SDL display driver for 320x172 RGB565
 */

/ {
	chosen {
		zephyr,display = &sdl_dc;
	};
};

&sdl_dc {
	status = "okay";
	width = <320>;
	height = <172>;
};
```

## src/main.c
```c
#include <zephyr/kernel.h>
#include <zephyr/device.h>
#include <zephyr/devicetree.h>
#include <zephyr/drivers/display.h>
#include <stdio.h>

#include "egfx.h"

// Get display device from devicetree
#define DISPLAY_NODE DT_CHOSEN(zephyr_display)

// eGFX back buffer storage
static uint8_t frame_buffer[eGFX_PHYSICAL_SCREEN_SIZE_X * eGFX_PHYSICAL_SCREEN_SIZE_Y * 2];
static egfx_img back_buffer;

int main(void)
{
	const struct device *display_dev;
	struct display_capabilities caps;
	struct display_buffer_descriptor buf_desc;
	int ret;

	printk("eGFX Test for Zephyr native_sim - 320x172 16BPP RGB565\n");

	// Get display device
	display_dev = DEVICE_DT_GET(DISPLAY_NODE);
	if (!device_is_ready(display_dev)) {
		printk("Display device not ready\n");
		return -1;
	}

	// Get display capabilities
	display_get_capabilities(display_dev, &caps);
	printk("Display: %dx%d, format: %d\n", caps.x_resolution, caps.y_resolution, caps.current_pixel_format);

	// Initialize eGFX back buffer
	egfx_image_plane_init(&back_buffer,
	                      frame_buffer,
	                      eGFX_PHYSICAL_SCREEN_SIZE_X,
	                      eGFX_PHYSICAL_SCREEN_SIZE_Y,
	                      eGFX_DISPLAY_DRIVER_IMG_TYPE);

	printk("eGFX buffer initialized: %dx%d\n", back_buffer.size_x, back_buffer.size_y);

	// Turn on display
	display_blanking_off(display_dev);

	// Setup buffer descriptor for display_write
	buf_desc.buf_size = eGFX_PHYSICAL_SCREEN_SIZE_X * eGFX_PHYSICAL_SCREEN_SIZE_Y * 2;
	buf_desc.width = eGFX_PHYSICAL_SCREEN_SIZE_X;
	buf_desc.height = eGFX_PHYSICAL_SCREEN_SIZE_Y;
	buf_desc.pitch = eGFX_PHYSICAL_SCREEN_SIZE_X;

	// Main rendering loop
	int frame = 0;
	while (1) {
		// Clear screen to white
		egfx_fill(&back_buffer, EGFX_COLOR_RGB888_TO_RGB565(255, 255, 255));

		// Draw some test content
		egfx_text(&back_buffer, "Zephyr eGFX Test", (egfx_point){5, 5},
			&(egfx_text_config){.font = &font_10_14, .colored = true, .color = {255, 0, 0}, .antialiased = false});

		char buf[32];
		snprintf(buf, sizeof(buf), "Frame: %d", frame++);
		egfx_text(&back_buffer, buf, (egfx_point){5, 25},
			&(egfx_text_config){.font = &font_5_7, .colored = true, .color = {0, 0, 255}, .antialiased = false});

		// Write buffer to display
		ret = display_write(display_dev, 0, 0, &buf_desc, frame_buffer);
		if (ret != 0) {
			printk("display_write failed: %d\n", ret);
		}

		// Delay for next frame (60 FPS = ~16ms)
		k_msleep(16);
	}

	return 0;
}
```

## src/eGFX_Config.h
```c
#ifndef _EGFX_CONFIG_H_
#define _EGFX_CONFIG_H_

/***
 *       ____
 *      / ___|___  _ __ ___
 *     | |   / _ \| '__/ _ \
 *     | |__| (_) | | |  __/
 *      \____\___/|_|  \___|
 *
 */

#ifdef _MSC_VER
	#define EGFX_WEAK
#else
	#define EGFX_WEAK                                          __attribute__((weak))
#endif

// Get configuration from Zephyr Kconfig
#ifdef CONFIG_EGFX_PHYSICAL_SCREEN_SIZE_X
    #define eGFX_PHYSICAL_SCREEN_SIZE_X CONFIG_EGFX_PHYSICAL_SCREEN_SIZE_X
#else
    #define eGFX_PHYSICAL_SCREEN_SIZE_X 320
#endif

#ifdef CONFIG_EGFX_PHYSICAL_SCREEN_SIZE_Y
    #define eGFX_PHYSICAL_SCREEN_SIZE_Y CONFIG_EGFX_PHYSICAL_SCREEN_SIZE_Y
#else
    #define eGFX_PHYSICAL_SCREEN_SIZE_Y 172
#endif

// Determine image type from Kconfig
#ifdef CONFIG_EGFX_DISPLAY_DRIVER_IMG_TYPE_1BPP
    #define eGFX_DISPLAY_DRIVER_IMG_TYPE EGFX_IMG_1BPP
#elif defined(CONFIG_EGFX_DISPLAY_DRIVER_IMG_TYPE_4BPP)
    #define eGFX_DISPLAY_DRIVER_IMG_TYPE EGFX_IMG_4BPP
#elif defined(CONFIG_EGFX_DISPLAY_DRIVER_IMG_TYPE_8BPP)
    #define eGFX_DISPLAY_DRIVER_IMG_TYPE EGFX_IMG_8BPP
#elif defined(CONFIG_EGFX_DISPLAY_DRIVER_IMG_TYPE_16BPP_RGB565)
    #define eGFX_DISPLAY_DRIVER_IMG_TYPE EGFX_IMG_16BPP_RGB565
#elif defined(CONFIG_EGFX_DISPLAY_DRIVER_IMG_TYPE_32BPP_XRGB888)
    #define eGFX_DISPLAY_DRIVER_IMG_TYPE EGFX_IMG_32BPP_XRGB888
#else
    #define eGFX_DISPLAY_DRIVER_IMG_TYPE EGFX_IMG_16BPP_RGB565
#endif

#ifdef CONFIG_EGFX_NUM_BACKBUFFERS
    #define eGFX_NUM_BACKBUFFERS CONFIG_EGFX_NUM_BACKBUFFERS
#else
    #define eGFX_NUM_BACKBUFFERS 1
#endif

#define CONFIG_EGFX_PUT_PIXEL_FLIP_X                                     (0)
#define CONFIG_EGFX_PUT_PIXEL_FLIP_Y                                     (0)

/*
        0 to allocate as static
        1 to allocate on stack
*/
#define CONFIG_EGFX_STRING_BUF_ALLOC                                     (0)
#define CONFIG_EGFX_MAX_PRINTF_BUF_LENGTH                                (64)
#define CONFIG_EGFX_SPACES_PER_TAB                                       (4)
#define CONFIG_EGFX_MAX_STRING_LEN                                       (64)

/***
 *      ____  __  __ ____     ___        _               _
 *     | __ )|  \/  |  _ \   / _ \ _   _| |_ _ __  _   _| |_
 *     |  _ \| |\/| | |_) | | | | | | | | __| '_ \| | | | __|
 *     | |_) | |  | |  __/  | |_| | |_| | |_| |_) | |_| | |_
 *     |____/|_|  |_|_|      \___/ \__,_|\__| .__/ \__,_|\__|
 *                                          |_|
 */

#define CONFIG_EGFX_INCLUDE_BITMAP_OUTPUT_SUPPORT  (0)

// Note: Using Zephyr display driver API directly, not eGFX display driver

#endif
```
